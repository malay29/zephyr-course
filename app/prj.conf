## CMakeLists.txt
```
cmake_minimum_required(VERSION 3.20.0)

#list(APPEND BOARD_ROOT ${CMAKE_CURRENT_SOURCE_DIR})
find_package(Zephyr REQUIRED HINTS $ENV{ZEPHYR_BASE}) # we tell cmake to look for zephyr 
project(my_zephyr_app)

target_sources(app PRIVATE src/main.cpp) # the app target is created, and we can add the src files, app name is always app, we can make changes in the project name but here it needs to be app
add_subdirectory(drivers/our_driver)
```

## Kconfig
```
menuconfig LED_Subsystem
    bool "LED Subsystem"
    default y

if LED_Subsystem

choice 
    prompt "LED blink sleep time"
    default BLINK_SLEEP_TIME_1000MS

config BLINK_SLEEP_TIME_250MS
    bool "Fast"
    help
      Set the sleep time for the blink application to 250 milliseconds.
    
config BLINK_SLEEP_TIME_1000MS
    bool "1s (Medium)"

config BLINK_SLEEP_TIME_2000MS
    bool "2s (Slow)"
    help
      Set the sleep time for the blink application to 2000 milliseconds.
endchoice

config BLINK_SLEEP_TIME_MS
    int 
    default 250 if BLINK_SLEEP_TIME_250MS
    default 1000 if BLINK_SLEEP_TIME_1000MS
    default 2000 if BLINK_SLEEP_TIME_2000MS
    default 0

config APP_HEARTBEAT_PERIOD_MS
    int "Application heartbeat period (100 - 2000 ms)"
    range 100 2000
    default 500
    
menuconfig LED_ADVANCED_SETTINGS
    bool "Advanced LED settings"
    default n

if LED_ADVANCED_SETTINGS

  config LED_BRIGHTNESS
      int "LED brightness (0-100)"
      range 0 100
      default 100

  config LED_FADE_DURATION_MS
      int "LED fade duration (ms)"
      range 0 5000
      default 500

menu "Expert Settings"

config LED_DEBUG
  bool "Enable LED debugging"
  

config Custom_Blink_pattern
    bool "Custom Blink Pattern"
    
endmenu
endif
endif
source "Kconfig.zephyr"
rsource "drivers/our_driver/Kconfig"

# choice 
#     prompt "LED Subsystem"
#     default BLINK_SLEEP_TIME_1000MS

# config BLINK_SLEEP_TIME_250MS
#     bool "Fast"
#     help
#       Set the sleep time for the blink application to 250 milliseconds.
    
# config BLINK_SLEEP_TIME_1000MS
#     bool "Medium"

# config BLINK_SLEEP_TIME_2000MS
#     bool "Slow"
#     help
#       Set the sleep time for the blink application to 2000 milliseconds.
# endchoice

# config BLINK_SLEEP_TIME_MS
#     int 
#     default 250 if BLINK_SLEEP_TIME_250MS
#     default 1000 if BLINK_SLEEP_TIME_1000MS
#     default 2000 if BLINK_SLEEP_TIME_2000MS
#     default 0
       

# source "Kconfig.zephyr"
```

## prj.conf
```kconfig
CONFIG_GPIO=y
CONFIG_LOG=y
CONFIG_SENSOR=y
CONFIG_OUR_DRIVER=y
CONFIG_SHELL=y

# Module 2, notes
# It is project configuration file, Kconfig uses this file, 
# this needs to be there, even if project config file is empty
```

## app.overlay
```dts
/*
/{
	aliases{
		app-led = &led0;
	};

};
*/

/*Driver Development */

/{
	our_driver0: our_driver {
		compatible = "our,driver";
		status = "okay";

		callibration = <50>;
	};
};
```

## dts/bindings/our,driver.yaml
```yaml
description: Our custom sensor driver binding
compatible: "our,driver"

properties:
  callibration:
    description: Calibration value for the sensor
    type: int
```

## src/main.cpp
```c
#include <zephyr/drivers/gpio.h>
#include <zephyr/drivers/sensor.h>
#include <zephyr/kernel.h>
#include <zephyr/logging/log.h>
#include "../drivers/our_driver/inc/our_driver.h"

#define SLEEP_TIME_MS 5000

/* The devicetree node identifier for the "led0" alias. */
#define LED_NODE DT_ALIAS(led0)
//#define LED_NODE DT_ALIAS(app_led)

static const struct gpio_dt_spec led = GPIO_DT_SPEC_GET(LED_NODE, gpios);

LOG_MODULE_REGISTER(main, LOG_LEVEL_INF);

// namespace {
//     void test() {
//         const struct device *driver = DEVICE_DT_GET(DT_NODELABEL(our_driver0));
//         struct sensor_value val;
//         auto ret = sensor_channel_get(driver, SENSOR_CHAN_AMBIENT_TEMP, &val);
//         LOG_INF("sensor_channel_get returned %d", ret);
//         auto ret2 = sensor_sample_fetch(driver);
//         LOG_INF("sensor_sample_fetch returned %d", ret2);
//     }
// }



int main(void)
{
    //test();

    const struct device *driver = DEVICE_DT_GET(DT_NODELABEL(our_driver0));
    struct sensor_value val;

    our_driver_set_counter(driver, 45);


    bool led_state = true;

    // if (!gpio_is_ready_dt(&led)) return 0;

    // if (gpio_pin_configure_dt(&led, GPIO_OUTPUT_ACTIVE) < 0) return 0;

    // while (1) {
    //     if (gpio_pin_toggle_dt(&led) < 0) return 0;

    //     led_state = !led_state;
    //     LOG_INF("LED state: %s", led_state ? "ON" : "OFF");
    //     k_msleep(CONFIG_APP_HEARTBEAT_PERIOD_MS);
    // }

    while(1) {
      //  auto ret = sensor_sample_fetch(driver);
      //  LOG_INF("sensor_sample_fetch returned %d", ret);
        //k_msleep(CONFIG_APP_HEARTBEAT_PERIOD_MS);
      //  k_msleep(SLEEP_TIME_MS);
     //   auto ret1 = sensor_channel_get(driver, SENSOR_CHAN_AMBIENT_TEMP, &val);
      //  LOG_INF("sensor_channel_get returned %d", ret1);
        //k_msleep(CONFIG_APP_HEARTBEAT_PERIOD_MS);
        k_msleep(SLEEP_TIME_MS);
    }
    return 0;
}
```
