## app/drivers/our_driver/Kconfig
```kconfig
config OUR_DRIVER
    bool "Our Driver"
    help
      Enable support for Our Driver.
```

## hello_world/boards/my_board_scratch/Kconfig.defconfig
```kconfig
if BOARD_MY_BOARD_SCRATCH
config BOARD_EARLY_INIT_HOOK
	default y
endif # BOARD_MY_BOARD_SCRATCH
```

## hello_world/boards/my_board_scratch/Kconfig.my_board_scratch
```kconfig
config BOARD_MY_BOARD_SCRATCH
    select SOC_NRF5340_CPUAPP_QKAA if BOARD_MY_BOARD_SCRATCH_NRF5340_CPUAPP || \
					  BOARD_MY_BOARD_SCRATCH_NRF5340_CPUAPP_NRF7001
```

## hello_world/boards/my_board_scratch/board.yml
```yaml
board: 
  name: my_board_scratch
  full_name: My Board From Scratch
  vendor: iomico
  socs:
    - name: nrf5340
      variants:
        - name: nrf7001
          cpucluster: cpuapp
```

## hello_world/boards/our_board/Kconfig.our_board
```kconfig
# Copyright (c) 2024 Nordic Semiconductor
# SPDX-License-Identifier: Apache-2.0

config BOARD_OUR_BOARD
	select SOC_NRF5340_CPUNET_QKAA if BOARD_OUR_BOARD_NRF5340_CPUNET
	select SOC_NRF5340_CPUAPP_QKAA if BOARD_OUR_BOARD_NRF5340_CPUAPP || \
					  BOARD_OUR_BOARD_NRF5340_CPUAPP_NRF7001
```
